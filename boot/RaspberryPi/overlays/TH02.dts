// Overlay for TH02 temperature and humidity sensor

/dts-v1/;
/plugin/;

/{
	compatible = "brcm,bcm2835";

	fragment@0 {
		target = <&i2c_arm>;
		__overlay__ {
			#address-cells = <1>;
			#size-cells = <0>;
			status = "okay";

			th02: th02@40 {
				compatible = "th02";
				reg = <0x40>;
				status = "okay";
			};
		};
	};
};
