// Overlay for BME280 temperature, humidity, and pressure sensor

/dts-v1/;
/plugin/;

/{
	compatible = "brcm,bcm2835";

	fragment@0 {
		target = <&i2c_arm>;
		__overlay__ {
			#address-cells = <1>;
			#size-cells = <0>;
			status = "okay";

			bme280: bme280@76 {
				compatible = "bme280";
				reg = <0x76>;
				status = "okay";
			};
		};
	};

	__overrides__ {
		addr = <&bme280>,"reg:0";
	};
};
