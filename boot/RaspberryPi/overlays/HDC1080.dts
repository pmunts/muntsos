// Overlay for HDC1080 temperature and humidity sensor

/dts-v1/;
/plugin/;

/{
	compatible = "brcm,bcm2835";

	fragment@0 {
		target = <&i2c_arm>;
		__overlay__ {
			#address-cells = <1>;
			#size-cells = <0>;
			status = "okay";

			hdc1080: hdc1080@40 {
				compatible = "hdc1080";
				reg = <0x40>;
				status = "okay";
			};
		};
	};
};
