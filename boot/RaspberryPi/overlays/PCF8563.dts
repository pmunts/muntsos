// Definitions for an NXP PCF8563 I2C Real Time Clock at I2C bus 1 address 0x51

/dts-v1/;
/plugin/;

/{
	compatible = "brcm,bcm2708";

	fragment@0 {
		target = <&i2c>;
		__overlay__ {
			#address-cells = <1>;
			#size-cells = <0>;
			status = "okay";

			pcf: pcf@51 {
				compatible = "nxp,pcf8563";
				#pwm-cells = <2>;
				reg = <0x51>;
				status = "okay";
			};
		};
	};

	__overrides__ {
		addr = <&pcf>,"reg:0";
	};
};
