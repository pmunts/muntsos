// Overlay for MCP3421-8 ADCs from Microchip Semiconductor

/dts-v1/;
/plugin/;

/{
	compatible = "brcm,bcm2835";

	fragment@1 {
		target = <&i2c_arm>;
		__overlay__ {
			#address-cells = <1>;
			#size-cells = <0>;
			status = "okay";

			mcp3428: mcp3428@68 {
				compatible = "mcp3428";
				reg = <0x68>;
				status = "okay";
			};
		};
	};

	__overrides__ {
		addr = <&mcp3428>,"reg:0";
	};
};
