// Overlay for TMP102 temperature and humidity sensor

/dts-v1/;
/plugin/;

/{
	compatible = "brcm,bcm2835";

	fragment@0 {
		target = <&i2c_arm>;
		__overlay__ {
			#address-cells = <1>;
			#size-cells = <0>;
			status = "okay";

			tmp102: tmp102@48 {
				compatible = "tmp102";
				reg = <0x48>;
				status = "okay";
			};
		};
	};

	__overrides__ {
		addr = <&tmp102>,"reg:0";
	};
};
