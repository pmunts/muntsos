// Definitions for an NXP PCA9685A I2C PWM controller at I2C bus 1 address 0x40

/dts-v1/;
/plugin/;

/{
	compatible = "brcm,bcm2708";

	fragment@0 {
		target = <&i2c>;
		__overlay__ {
			#address-cells = <1>;
			#size-cells = <0>;
			status = "okay";

			pca: pca@40 {
				compatible = "nxp,pca9685";
				#pwm-cells = <2>;
				reg = <0x40>;
				status = "okay";
			};
		};
	};

	__overrides__ {
		addr = <&pca>,"reg:0";
	};
};
