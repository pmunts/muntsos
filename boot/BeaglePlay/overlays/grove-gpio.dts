// Change Grove socket from I2C to GPIO

/dts-v1/;
/plugin/;

/ {
	compatible = "beagle,am625-beagleplay";

	fragment@0 {
		target = <&main_i2c1>;
		__overlay__ {
			status = "disabled";
		};
	};

	fragment@1 {
		target = <&main_gpio1>;
		__overlay__ {
			pinctrl-names = "default";
			pinctrl-0 = <&mikrobus_gpio_pins_default>, <&grove_gpio_pins>;
		};
	};
};
