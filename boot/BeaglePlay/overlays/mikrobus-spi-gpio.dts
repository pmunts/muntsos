// Configure mikroBUS SPI pins as GPIO

/dts-v1/;
/plugin/;

/ {
	compatible = "beagle,am625-beagleplay";

	fragment@0 {
		target = <&main_spi2>;
		__overlay__ {
			pinctrl-names = "default";
			pinctrl-0 = <&mikrobus_spi_gpio_pins>;
		};
	};
};
