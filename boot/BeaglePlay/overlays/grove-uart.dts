// Configure Grove socket as a serial port

/dts-v1/;
/plugin/;

/ {
	compatible = "beagle,am625-beagleplay";

	fragment@0 {
		target = <&main_uart1>;
		__overlay__ {
			pinctrl-names = "default";
			pinctrl-0 = <&grove_uart_pins>;
		};
	};
};
