// Configure mikroBUS PWM pins as GPIO

/dts-v1/;
/plugin/;

/ {
	compatible = "beagle,am625-beagleplay";

	fragment@0 {
		target = <&ecap2>;
		__overlay__ {
			pinctrl-names = "default";
			pinctrl-0 = <&mikrobus_pwm_gpio_pins>;
		};
	};
};
