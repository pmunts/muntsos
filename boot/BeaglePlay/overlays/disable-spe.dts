// Disable 10BASE-T1L Single Pair Ethernet interface

/dts-v1/;
/plugin/;

/ {
	compatible = "beagle,am625-beagleplay";

	fragment@0 {
		target = <&cpsw_port2>;
		__overlay__ {
			status = "disabled";
		};
	};
};
