/*
 * Copyright (C) 2012 Texas Instruments Incorporated - http://www.ti.com/
 *
 * This program is free software; you can redistribute it and/or modify
 * it under the terms of the GNU General Public License version 2 as
 * published by the Free Software Foundation.
 */
/dts-v1/;
/plugin/;

/ {
	compatible = "ti,am335x-pocketbeagle";

	// identification
	part-number = "PB-ADC";
	version = "00A0";

	// resources this cape uses
	exclusive-use =
		"P1.19",		// AIN0 1.8V
		"P1.21",		// AIN1 1.8V
		"P1.23",		// AIN2 1.8V
		"P1.25",		// AIN3 1.8V
		"P1.27",		// AIN4 1.8V
		"P2.35",		// AIN5 3.3V
		"P1.2",			// AIN6 3.3V
		"P2.36",		// AIN7 1.8V

		"tscadc";	// hardware ip used


	fragment@0 {
		target = <&tscadc>;
		__overlay__ {

			status = "okay";
			adc {
				ti,adc-channels = <0 1 2 3 4 5 6 7>;
				ti,chan-step-avg = <0x16 0x16 0x16 0x16 0x16 0x16 0x16 0x16>;
				ti,chan-step-opendelay = <0x98 0x98 0x98 0x98 0x98 0x98 0x98 0x98>;
				ti,chan-step-sampledelay = <0x0 0x0 0x0 0x0 0x0 0x0 0x0 0x0>;
			};
		};
	};
};
